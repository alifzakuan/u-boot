## configs/socfpga_stratix10_emmc_defconfig
```kconfig
#include <configs/socfpga_stratix10_defconfig>

CONFIG_DEFAULT_DEVICE_TREE="socfpga_stratix10_socdk_emmc"
CONFIG_OF_LIST="socfpga_stratix10_socdk_emmc"
```
